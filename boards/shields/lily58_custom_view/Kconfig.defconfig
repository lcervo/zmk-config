## boards/shields/lily58_custom_view/Kconfig.defconfig
```kconfig
# Copyright (c) 2022 The ZMK Contributors
# SPDX-License-Identifier: MIT

if SHIELD_LILY58_CUSTOM_VIEW

config NICE_VIEW_WIDGET_STATUS
    bool "Custom nice!view status widget"
    select LV_FONT_MONTSERRAT_16
    select LV_USE_IMG
    select LV_USE_CANVAS

if NICE_VIEW_WIDGET_STATUS

config ZMK_DISPLAY_STATUS_SCREEN_CUSTOM
    default y

config ZMK_DISPLAY
    default y

endif # NICE_VIEW_WIDGET_STATUS

endif # SHIELD_LILY58_CUSTOM_VIEW
```

## boards/shields/lily58_custom_view/Kconfig.shield
```kconfig
# Copyright (c) 2022 The ZMK Contributors
# SPDX-License-Identifier: MIT

config SHIELD_LILY58_CUSTOM_VIEW
    def_bool $(shields_list_contains,lily58_custom_view)
```

## boards/shields/narfpad/Kconfig.defconfig
```kconfig
if SHIELD_NARFPAD

config ZMK_KEYBOARD_NAME
    default "NarfPad"

config ZMK_SLEEP
    default y

config ZMK_IDLE_SLEEP_TIMEOUT
    default 900000

endif
```
